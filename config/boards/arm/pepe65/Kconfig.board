## config/boards/arm/pepe65/Kconfig.board
```kconfig
# Copyright (c) 2020-2021 Thys de Wet (vattern)
# SPDX-License-Identifier: MIT



config BOARD_PEPE65
	bool "pepe65"
	depends on SOC_NRF52840_QIAA
```

## config/boards/arm/pepe65/Kconfig.defconfig
```kconfig
# Copyright (c) 2020-2021 Thys de Wet (vattern)
# SPDX-License-Identifier: MIT

config ZMK_KEYBOARD_NAME
	default "pepe65"

if USB

config USB_NRFX
	default y

config USB_DEVICE_STACK
	default y

endif # USB

config BT_CTLR
	default BT

config ZMK_BLE
	default y

config ZMK_USB
	default y

config ZMK_BATTERY_VOLTAGE_DIVIDER
	default y
```

## config/boards/arm/pepe65/pepe65_defconfig
```kconfig
# SPDX-License-Identifier: MIT
CONFIG_BUILD_OUTPUT_UF2=y
CONFIG_SOC_SERIES_NRF52X=y
CONFIG_SOC_NRF52840_QIAA=y
CONFIG_BOARD_PEPE65=y

#Keyboard Name
CONFIG_ZMK_KEYBOARD_NAME="pepe65"


CONFIG_ZMK_USB_LOGGING=n


# Enable MPU
CONFIG_ARM_MPU=y

# enable GPIO
CONFIG_GPIO=y

CONFIG_USE_DT_CODE_PARTITION=y

# enable pwm
CONFIG_PWM=n
CONFIG_PWM_NRFX=n

CONFIG_MPU_ALLOW_FLASH_WRITE=y
CONFIG_NVS=y
CONFIG_SETTINGS_NVS=y
CONFIG_FLASH=y
CONFIG_FLASH_PAGE_LAYOUT=y
CONFIG_FLASH_MAP=y

# set TX power level
CONFIG_BT_CTLR_TX_PWR_PLUS_8=y

# Enable Underglow
CONFIG_ZMK_RGB_UNDERGLOW=n
CONFIG_WS2812_STRIP=n
CONFIG_ZMK_RGB_UNDERGLOW_EXT_POWER=n
CONFIG_ZMK_RGB_UNDERGLOW_ON_START=n

# Enable the rotary encoder
CONFIG_EC11=n
CONFIG_EC11_TRIGGER_GLOBAL_THREAD=n

# Enable sleep
CONFIG_ZMK_SLEEP=y
CONFIG_ZMK_IDLE_SLEEP_TIMEOUT=20000
```

## config/boards/shields/footster/Kconfig.defconfig
```kconfig
# Copyright (c) 2020 The ZMK Contributors
# SPDX-License-Identifier: MIT

if SHIELD_FOOTSTER

config ZMK_KEYBOARD_NAME
    default "footster"

endif
```

## config/boards/shields/footster/Kconfig.shield
```kconfig
# Copyright (c) 2020 The ZMK Contributors
# SPDX-License-Identifier: MIT

config SHIELD_FOOTSTER
    def_bool $(shields_list_contains,footster)
```

## config/boards/shields/icybear/Kconfig.defconfig
```kconfig
# Copyright (c) 2020 The ZMK Contributors
# SPDX-License-Identifier: MIT

if SHIELD_ICYBEAR

config ZMK_KEYBOARD_NAME
    default "icybear"

endif
```
